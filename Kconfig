## Kconfig
```kconfig
# SPDX-License-Identifier: GPL-2.0

config MT7668S_WIFI
	tristate "Mediatek MT7668S WiFi support"
	depends on MMC
	select CFG80211_WEXT
	select CFG80211_WEXT_EXPORT
	default m
	help
	  Enable support for the Mediatek MT7668S SDIO WiFi chipset.
	  This driver provides the necessary functionality to operate
	  the MT7668S chipset via SDIO interface.

	  To compile this driver as a loadable kernel module, choose 'M'
	  here. This will create a module named 'mt7668s.ko'.

config MT7668S_WIFI_PREALLOC
	bool "MT7668S WiFi Pre-alloc memory"
	depends on MT7668S_WIFI
	default n
	help
	  Enable this option to pre-allocate memory for MT7668S WiFi
	  operations. Pre-allocating memory can improve performance
	  by reducing dynamic memory allocation overhead during runtime.
	  This is useful in memory-constrained environments or for
	  improving latency.
```

## reinit/Kconfig
```kconfig
# SPDX-License-Identifier: GPL-2.0
config MT7668S_WIFI_REINIT
	tristate "MT7668S WiFi reinit support (Amlogic vendor kernel only)"
	depends on MT7668S_WIFI
	depends on AMLOGIC_WIFI
	default n
	help
	  Enable support for reinitializing the MT7668S WiFi module
	  in the Amlogic vendor kernel. This is particularly useful
	  for systems that require the WiFi module to be reset without
	  a full system reboot, such as in cases of WiFi module failure
	  or dynamic reconfiguration.

	  This option is dependent on the presence of the Amlogic driver,
	  ensuring that the necessary infrastructure is available for
	  reinitialization.

	  To compile this support as a loadable kernel module, choose 'M'
	  here. This will create a module named 'mt7668s_reinit.ko'.

	  Select 'y' to enable reinitialization support, ensuring
	  more robust WiFi operation in dynamic or fault-prone environments.
	  Select 'n' to disable this feature if it is not needed.
```
